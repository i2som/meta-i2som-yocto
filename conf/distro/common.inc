## conf/distro/common.inc
```bitbake
DISTRO_VERSION ??= "UNASSIGNED"
DISTRO_VERSION_ti33x = "2.2"
VENDOR = "i2SOM"
TARGET_VENDOR = "-${VENDOR}"

SDK_VENDOR = "-${VENDOR}sdk"
SDK_VERSION := "${DISTRO_VERSION}"
SDK_NAME = "${VENDOR}-${DISTRO}-${TCLIBC}-${SDK_ARCH}-${IMAGE_BASENAME}-${TUNE_PKGARCH}"
SDKPATH = "/opt/${VENDOR}-${DISTRO}/${SDK_VERSION}"

#activate config checker
INHERIT += "sanity"

#run QA tests on builds and packages and log them
INHERIT += "insane"
QA_LOG = "1"

# Prelink images
INHERIT += "image-prelink"

# optimize lib sizes with mklibs
INHERIT += "image-mklibs"

#run QA tests on recipes
#INHERIT += "recipe_sanity"

PACKAGE_CLASSES ?= "package_rpm"


# Uncomment below lines to enable systemd

#DISTRO_FEATURES_remove = "sysvinit"
#DISTRO_FEATURES += "systemd"
#VIRTUAL-RUNTIME_init_manager = "systemd"
#PREFERRED_PROVIDER_udev = "systemd"
#DISTRO_FEATURES_BACKFILL_CONSIDERED += "sysvinit"
#PREFERRED_PROVIDER_udev-utils = "systemd"
```

## conf/distro/i2SOM-fb.conf
```bitbake
require conf/distro/poky.conf
require common.inc

DISTRO = "i2SOM-fb"
DISTRO_NAME = "i2SOM Framebuffer (i2SOM Embedded Linux Distribution)"

DISTRO_FEATURES_remove = "opengl argp irda pcmcia zeroconf x11 ptest multiarch vulkan wayland"
DISTRO_FEATURES_DEFAULT_remove = " x11"

GRAPHICAL_BACKEND = "${@bb.utils.contains('DISTRO_FEATURES', 'x11', 'x11', 'fb', d)}"
POKY_DEFAULT_DISTRO_FEATURES_remove = "ptest wayland opengl"

# some default locales
IMAGE_LINGUAS ?= "zh-cn en-us"

PREFERRED_VERSION_nodejs = "6.%"
PREFERRED_VERSION_nodejs-native = "6.%"
```

## conf/distro/i2SOM-wayland.conf
```bitbake
require conf/distro/poky.conf
require common.inc

DISTRO = "i2SOM-wayland"
DISTRO_NAME = "i2SOM Yocto Wayland (i2SOM Wayland Distribution)"

DISTRO_FEATURES_append = " wayland"
DISTRO_FEATURES_remove = "argp irda pcmcia directfb x11 ptest"

# some default locales
IMAGE_LINGUAS ?= "zh-cn en-us"
```

## conf/layer.conf
```bitbake
# We have a conf and classes directory, append to BBPATH
BBPATH .= ":${LAYERDIR}"

# We have a recipes directory, add to BBFILES
BBFILES += "${LAYERDIR}/recipes*/*/*.bb ${LAYERDIR}/recipes*/*/*.bbappend"

BBFILE_COLLECTIONS += "i2som-yocto"
BBFILE_PATTERN_i2som-yocto := "^${LAYERDIR}/"
BBFILE_PRIORITY_i2som-yocto = "10"

# Layer dependencies
LAYERDEPENDS_i2som-yocto = "i2som-ti openembedded-layer networking-layer meta-python multimedia-layer qt5-layer"
```
